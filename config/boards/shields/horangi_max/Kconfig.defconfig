## config/boards/shields/horangi_max/Kconfig.defconfig
```kconfig
if SHIELD_HORANGI_MAX_LEFT

config ZMK_KEYBOARD_NAME
    default "horangi_max"

config ZMK_SPLIT_ROLE_CENTRAL
    default y

endif

if SHIELD_HORANGI_MAX_LEFT || SHIELD_HORANGI_MAX_RIGHT

config ZMK_SPLIT
    default y

endif
```

## config/boards/shields/horangi_max/Kconfig.shield
```kconfig
config SHIELD_HORANGI_MAX_LEFT
    def_bool $(shields_list_contains,horangi_max_left)

config SHIELD_HORANGI_MAX_RIGHT
    def_bool $(shields_list_contains,horangi_max_right)
```
